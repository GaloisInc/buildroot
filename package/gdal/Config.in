## package/gdal/Config.in
```kconfig
config BR2_PACKAGE_GDAL
	bool "GDAL"
        select BR2_PACKAGE_JPEG
        select BR2_PACKAGE_LIBPNG
        select BR2_PACKAGE_TIFF
        select BR2_PACKAGE_ZLIB
	help
          GDAL is a translator library for raster and vector
          geospatial data formats that is released under an X/MIT
          style Open Source license by the Open Source Geospatial
          Foundation. As a library, it presents a single raster
          abstract data model and single vector abstract data model to
          the calling application for all supported formats. It also
          comes with a variety of useful command line utilities for
          data translation and processing.

	  http://www.gdal.org/
```

## package/geographiclib/Config.in
```kconfig
config BR2_PACKAGE_GEOGRAPHICLIB
	bool "GeographicLib"
	help
	  GeographicLib is a small set of C++ classes for performing conversions
          between geographic, UTM, UPS, MGRS, geocentric, and local cartesian
          coordinates, for gravity (e.g., EGM2008), geoid height, and
          geomagnetic field (e.g., WMM2010) calculations, and for solving
          geodesic problems. 

	  https://geographiclib.sourceforge.io/
```
